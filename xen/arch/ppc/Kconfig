## xen/arch/ppc/Kconfig
```kconfig
config 64BIT
	bool
	default "$(ARCH)" != "ppc32"
	help
	  Say yes to build a 64-bit Xen
	  Say no to build a 32-bit Xen

config PPC_64
	def_bool y
	depends on 64BIT

config PPC
	def_bool y
	select HAS_DEVICE_TREE

menu "Architecture Features"

source "arch/Kconfig"

endmenu

#source "arch/ppc/platforms/Kconfig"

source "common/Kconfig"

source "drivers/Kconfig"
```
